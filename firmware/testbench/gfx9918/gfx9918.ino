// Artemisa Computer System
// GFX9918 Testbench
// Copyright (C) 2018-2019 Alvaro Polo
//
// This is an Arduino sketch aimed to provide a testbench for the GFX9918
// board. It basically makes the Arduino simulate an Artemisa Computer
// motherboard, interacting with the TMS9918 chip to show a message in the
// screen. It configures the screen mode 0, with a MSX color scheme and shows
// the welcome message of a MSX system in the screen.
//

// The VDP ports selected via A0
#define PORT_CONTROL  HIGH
#define PORT_DATA     LOW

// A macro that generates the control byte necessary to write into a VDP
// register.
#define CTRL_BYTE_WRITE_REG(reg) (0x80 | (reg & 0x07))

// Some useful macros to calculate base address of some tables in the VRAM.
#define BASE_ADDR_NAME_TABLE(addr) (byte(addr >> 10))
#define BASE_ADDR_COLOR_TABLE(addr) (byte(addr >> 6))
#define BASE_ADDR_PATTERNGEN_TABLE(addr) (byte(addr >> 11))
#define BASE_ADDR_SPRITEATTR_TABLE(addr) (byte(addr >> 7))
#define BASE_ADDR_SPRITEPATTERNGEN_TABLE(addr) (byte(addr >> 11))

// Use those mapping for MSX screen 0 (text)
#define VRAM_NAME_TABLE             0x0000
#define VRAM_COLOR_TABLE            0x1000
#define VRAM_PATTERNGEN_TABLE       0x0800
#define VRAM_SPRITEATTR_TABLE       0x1000
#define VRAM_SPRITEPATTERNGEN_TABLE 0x1000

// Some colors of the 9918 palette
#define COLOR_BLACK     0x01
#define COLOR_GREEN     0x02
#define COLOR_DARKBLUE  0x04
#define COLOR_LIGHTBLUE 0x05
#define COLOR_RED       0x08
#define COLOR_MAGENTA   0x0d
#define COLOR_WHITE     0x0f

// The colors to be configured
#define COLOR_FOREGROUND COLOR_WHITE
#define COLOR_BACKGROUND COLOR_LIGHTBLUE

#if defined(ARDUINO_AVR_UNO)
  // Pinout for Arduino Uno
  const int pin_data[] PROGMEM    = { A0, A1, A2, A3, A4, A5, 12, 13 };
  const int pin_vdpsel PROGMEM    = 2;
  const int pin_wr PROGMEM        = 3;
  const int pin_rd PROGMEM        = 4;
  const int pin_irq PROGMEM       = 5;
  const int pin_reset PROGMEM     = 6;
  const int pin_a0 PROGMEM        = 7;
#elif defined(ARDUINO_AVR_MEGA) || defined(ARDUINO_AVR_MEGA2560)
  // Pinout for Arduino Mega 2560
  const int pin_data[] PROGMEM    = { 22, 23, 24, 25, 26, 27, 28, 29 };
  const int pin_vdpsel PROGMEM    = 2;
  const int pin_wr PROGMEM        = 3;
  const int pin_rd PROGMEM        = 4;
  const int pin_irq PROGMEM       = 5;
  const int pin_reset PROGMEM     = 6;
  const int pin_a0 PROGMEM        = 7;
#else
  #error Unsupported board selection.
#endif

// The charset to be used to write strings into screen. 
// Quite large, full declaration at the bottom of this source file.
extern const byte charset[256*8] PROGMEM;

void setup() {
  delay(2000); // Let the power flow
  Serial.begin(9600);
  setup_control();
  setup_data(INPUT);
  reset();
  init_device();
}

// Setup the control lines
void setup_control() {
  pinMode(pin_irq, INPUT);

  digitalWrite(pin_vdpsel, HIGH);
  digitalWrite(pin_wr, HIGH);
  digitalWrite(pin_rd, HIGH);
  digitalWrite(pin_reset, HIGH);
  digitalWrite(pin_a0, LOW);

  pinMode(pin_vdpsel, OUTPUT);
  pinMode(pin_wr, OUTPUT);
  pinMode(pin_rd, OUTPUT);
  pinMode(pin_reset, OUTPUT);
  pinMode(pin_a0, OUTPUT);
}

// Set the data bus. `mode` indicates the direction of the bus (INPUT or
// OUTPUT).
void setup_data(int mode) {
  for (int i = 0; i < 8; i++) {
    pinMode(pin_data[i], mode);
  }
}

// Send a reset pulse to the VDP
void reset() {
  digitalWrite(pin_reset, LOW);
  delayMicroseconds(200);
  digitalWrite(pin_reset, HIGH);
}

// Initialize the VDP
void init_device() {
  // General control flags
  write_register(0, 0b00000000);
  write_register(1, 0b11010000); // note: no interrupts

  // Color attributes for screen 0
  write_register(7, (COLOR_FOREGROUND << 4) | COLOR_BACKGROUND);

  // Name table base address
  write_register(2, BASE_ADDR_NAME_TABLE(VRAM_NAME_TABLE));

  // Color table
  write_register(3, BASE_ADDR_COLOR_TABLE(VRAM_COLOR_TABLE));

  // Pattern generator table
  write_register(4, BASE_ADDR_PATTERNGEN_TABLE(VRAM_PATTERNGEN_TABLE));

  // Sprite attribute table
  write_register(5, BASE_ADDR_SPRITEATTR_TABLE(VRAM_SPRITEATTR_TABLE));

  // Sprite pattern generator table
  write_register(6, BASE_ADDR_SPRITEPATTERNGEN_TABLE(VRAM_SPRITEPATTERNGEN_TABLE));

  // Write the charset to the pattern table
  write_vram(VRAM_PATTERNGEN_TABLE, charset, 256*8);

  fill_vram(VRAM_NAME_TABLE, 0, 40*24);

  // Write a welcome message
  write_vram(VRAM_NAME_TABLE, F("MSX BASIC version 1.0"));
  write_vram(VRAM_NAME_TABLE + 40, F("Copyright 1983 by Microsoft"));
  write_vram(VRAM_NAME_TABLE + 40*2, F("28815 Bytes free"));
  write_vram(VRAM_NAME_TABLE + 40*3, F("Ok"));
  write_vram(VRAM_NAME_TABLE + 40*23, F("color   auto    goto    list    run"));
}

// Write given `data` into given `reg`ister.
void write_register(int reg, byte data) {
  setup_data(OUTPUT);
  write_data(data, PORT_CONTROL);
  write_data(CTRL_BYTE_WRITE_REG(reg), PORT_CONTROL);
  setup_data(INPUT);
}

// Read status register
byte read_register() {
  return read_data(PORT_CONTROL);
}

// Write `nbytes` of `data` to VRAM at given `address`
void write_vram(word address, const byte *data, word nbytes) {
  write_data(byte(address), PORT_CONTROL);
  write_data(byte(address >> 8) | 0x40, PORT_CONTROL);
  for (word i = 0; i < nbytes; i++) {
    write_data(data[i], PORT_DATA);
  }
}

// Write a string to VRAM at given `address`
void write_vram(word address, const String &data) {
  write_vram(address, (const byte*) data.c_str(), data.length());
}

// Fill VRAM at `address` with `nbytes` repetitions of `data`
void fill_vram(word address, byte data, word nbytes) {
  write_data(byte(address), PORT_CONTROL);
  write_data(byte(address >> 8) | 0x40, PORT_CONTROL);
  for (word i = 0; i < nbytes; i++) {
    write_data(data, PORT_DATA);
  }
}

// Read `nbytes` of data from VRAM at `address` and store it in `data` buffer
void read_vram(word address, byte *data, word nbytes) {
  write_data(byte(address), PORT_CONTROL);
  write_data(byte(address >> 8), PORT_CONTROL);
  for (word i = 0; i < nbytes; i++) {
    data[i] = read_data(PORT_DATA);
  }
}

// Perform a VRAM check. It writes some bytes in VRAM and read them back to
// check the whole cycle is successful.
void check_vram(word address, byte *expected, word nbytes) {
  byte buff[nbytes];
  read_vram(address, buff, nbytes);
  for (word i = 0; i < nbytes; i++) {
    if (expected[i] != buff[i]) {
      Serial.print(F("Invalid byte at address h"));
      Serial.print(address + i, HEX);
      Serial.print(F("; expected h"));
      Serial.print(expected[i], HEX);
      Serial.print(F(" but h"));
      Serial.print(buff[i], HEX);
      Serial.println(F(" given"));
    }
  }
}

// Low level data writing operation. Write given `data` byte in given `port`
void write_data(byte data, int port) {
  setup_data(OUTPUT);
  for (int i = 0; i < 8; i++) {
    digitalWrite(pin_data[i], data & 0x01);
    data >>= 1;
  }
  digitalWrite(pin_a0, port);
  digitalWrite(pin_wr, LOW);
  digitalWrite(pin_vdpsel, LOW);
  delayMicroseconds(20);
  digitalWrite(pin_vdpsel, HIGH);
  digitalWrite(pin_wr, HIGH);
  setup_data(INPUT);
}

// Low level data reading operation. Read a byte from given `port`.
byte read_data(int port) {
  byte data = 0;
  digitalWrite(pin_a0, port);
  digitalWrite(pin_rd, LOW);
  digitalWrite(pin_vdpsel, LOW);
  for (int i = 0; i < 8; i++) {
    data <<= 1;
    data |= digitalRead(pin_data[i]);
  }
  digitalWrite(pin_vdpsel, HIGH);
  digitalWrite(pin_rd, HIGH);
  return data;
}

void loop() {
}

const byte charset[256*8] PROGMEM = {
    0x00,0x00,0x00,0x00,0x00,0x00,0x00,0x00,    // 0
    0x3C,0x42,0xA5,0xA5,0xC3,0xBD,0x42,0x3C,    // 1
    0x3C,0x7E,0xDB,0xDB,0xBD,0xC3,0x7E,0x3C,    // 2
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    0xAA,0x55,0xAA,0x55,0xAA,0x55,0xAA,0x55     // 255
};
